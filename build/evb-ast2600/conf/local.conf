## build/evb-ast2600/conf/local.conf
```bitbake
MACHINE ??= "evb-ast2600"
DISTRO ?= "openbmc-phosphor"
PACKAGE_CLASSES ?= "package_ipk"
SANITY_TESTED_DISTROS:append ?= " *"
EXTRA_IMAGE_FEATURES ?= "debug-tweaks"
USER_CLASSES ?= "buildstats"
PATCHRESOLVE = "noop"
BB_DISKMON_DIRS ??= "\
    STOPTASKS,${TMPDIR},1G,100K \
    STOPTASKS,${DL_DIR},1G,100K \
    STOPTASKS,${SSTATE_DIR},1G,100K \
    STOPTASKS,/tmp,100M,100K \
    HALT,${TMPDIR},100M,1K \
    HALT,${DL_DIR},100M,1K \
    HALT,${SSTATE_DIR},100M,1K \
    HALT,/tmp,10M,1K"
CONF_VERSION = "2"

require conf/machine/include/obmc-bsp-common.inc

INIT_MANAGER = "systemd"

IMAGE_INSTALL:remove:pn-obmc-phosphor-image = "dbus-broker"
IMAGE_INSTALL:append:pn-obmc-phosphor-image = " dbus socat tcpdump strace lsof"

#VIRTUAL-RUNTIME_base-utils = "packagegroup-core-base-utils"

OE_TERMINAL = "tmux"
```

## build/imx6ullevk/conf/bblayers.conf
```bitbake
# LAYER_CONF_VERSION is increased each time build/conf/bblayers.conf
# changes incompatibly
# /home/gxh/new_openbmc/openbmc/meta-freescale-distro 
# /home/gxh/new_openbmc/openbmc/meta-freescale-3rdparty 
# /home/gxh/new_openbmc/openbmc/meta-imx/meta-imx-sdk 

LCONF_VERSION = "8"
BBPATH = "${TOPDIR}"
BBFILES ?= ""

BBLAYERS ?= " \
  /home/gxh/new_openbmc/openbmc/meta \
  /home/gxh/new_openbmc/openbmc/meta-poky \
  /home/gxh/new_openbmc/openbmc/meta-openembedded/meta-oe \
  /home/gxh/new_openbmc/openbmc/meta-openembedded/meta-networking \
  /home/gxh/new_openbmc/openbmc/meta-openembedded/meta-python \
  /home/gxh/new_openbmc/openbmc/meta-phosphor \
  /home/gxh/new_openbmc/openbmc/meta-freescale \
  /home/gxh/new_openbmc/openbmc/meta-imx/meta-imx-bsp \
  /home/gxh/new_openbmc/openbmc/meta-arm/meta-arm \
  /home/gxh/new_openbmc/openbmc/meta-arm/meta-arm-toolchain \
"
```

## build/imx6ullevk/conf/local.conf
```bitbake
MACHINE ??= "imx6ullevk"
DISTRO ?= "openbmc-phosphor"
PACKAGE_CLASSES ?= "package_ipk"
SANITY_TESTED_DISTROS:append ?= " *"
EXTRA_IMAGE_FEATURES ?= "debug-tweaks"
USER_CLASSES ?= "buildstats"
PATCHRESOLVE = "noop"
BB_DISKMON_DIRS ??= "\
    STOPTASKS,${TMPDIR},1G,100K \
    STOPTASKS,${DL_DIR},1G,100K \
    STOPTASKS,${SSTATE_DIR},1G,100K \
    STOPTASKS,/tmp,100M,100K \
    HALT,${TMPDIR},100M,1K \
    HALT,${DL_DIR},100M,1K \
    HALT,${SSTATE_DIR},100M,1K \
    HALT,/tmp,10M,1K"
CONF_VERSION = "2"

DISTRO_FEATURES:remove = "obmc-phosphor-system-mgmt"
ACCEPT_FSL_EULA = "1"

INIT_MANAGER = "systemd"

KERNEL_DEVICETREE:mx6ull-nxp-bsp:append = " nxp/imx/imx6ull-alientek-emmc.dtb"
```

## build/qemuarm64.bmc/conf/bblayers.conf
```bitbake
# LAYER_CONF_VERSION is increased each time build/conf/bblayers.conf
# changes incompatibly
LCONF_VERSION = "8"

BBPATH = "${TOPDIR}"
BBFILES ?= ""

BBLAYERS ?= " \
  /home/gxh/openbmc/meta \
  /home/gxh/openbmc/meta-openembedded/meta-oe \
  /home/gxh/openbmc/meta-openembedded/meta-networking \
  /home/gxh/openbmc/meta-openembedded/meta-python \
  /home/gxh/openbmc/meta-phosphor \
  "
```

## build/qemuarm64.bmc/conf/local.conf
```bitbake
MACHINE ??= "qemuarm64"
DISTRO ?= "openbmc-phosphor"
PACKAGE_CLASSES ?= "package_ipk"
SANITY_TESTED_DISTROS:append ?= " *"
EXTRA_IMAGE_FEATURES ?= "debug-tweaks"
USER_CLASSES ?= "buildstats"
PATCHRESOLVE = "noop"
BB_DISKMON_DIRS ??= "\
    STOPTASKS,${TMPDIR},1G,100K \
    STOPTASKS,${DL_DIR},1G,100K \
    STOPTASKS,${SSTATE_DIR},1G,100K \
    STOPTASKS,/tmp,100M,100K \
    HALT,${TMPDIR},100M,1K \
    HALT,${DL_DIR},100M,1K \
    HALT,${SSTATE_DIR},100M,1K \
    HALT,/tmp,10M,1K"
CONF_VERSION = "2"
MACHINE_FEATURES_BACKFILL_CONSIDERED = "qemu-usermode"


IMAGE_INSTALL:append:pn-obmc-phosphor-image = " phosphor-ipmi-net phosphor-ipmi-host"
IMAGE_INSTALL:append:pn-core-image-minimal = " dropbear"
IMAGE_INSTALL:append = " wget vim socat opkg opkg-utils"

IMAGE_INSTALL:remove = " dbus-broker"
IMAGE_INSTALL:add = " dbus"



IMAGE_ROOTFS_SIZE = "1048576"

DEFAULT_OPENBMC_PASSWORD = "'\$6\$UGMqyqdG\$GqTb3tXPFx9AJlzTw/8X5RoW2Z.100dT.acuk8AFJfNQYr.ZRL8itMIgLqsdq46RNHgiv78XayOSl.IbR4DFU.'"

EXTRA_USERS_PARAMS:pn-core-image-minimal = " \
  usermod -p ${DEFAULT_OPENBMC_PASSWORD} root; \
  "
```

## build/qemuarm64.graphic/conf/bblayers.conf
```bitbake
# POKY_BBLAYERS_CONF_VERSION is increased each time build/conf/bblayers.conf
# changes incompatibly
POKY_BBLAYERS_CONF_VERSION = "2"

BBPATH = "${TOPDIR}"
BBFILES ?= ""

BBLAYERS ?= " \
  /home/gxh/openbmc/meta \
  /home/gxh/openbmc/meta-poky \
  /home/gxh/openbmc/meta-openembedded/meta-oe \
  /home/gxh/openbmc/meta-openembedded/meta-python \
  /home/gxh/openbmc/meta-openembedded/meta-multimedia \
  /home/gxh/openbmc/meta-openembedded/meta-networking \
  /home/gxh/openbmc/meta-openembedded/meta-gnome \
  /home/gxh/openbmc/meta-openembedded/meta-xfce \
  "
```

## build/romulus/conf/bblayers.conf
```bitbake
# LAYER_CONF_VERSION is increased each time build/conf/bblayers.conf
# changes incompatibly
LCONF_VERSION = "8"

BBPATH = "${TOPDIR}"
BBFILES ?= ""

BBLAYERS ?= " \
  /home/gxh/new_openbmc/openbmc/meta \
  /home/gxh/new_openbmc/openbmc/meta-openembedded/meta-oe \
  /home/gxh/new_openbmc/openbmc/meta-openembedded/meta-networking \
  /home/gxh/new_openbmc/openbmc/meta-openembedded/meta-perl \
  /home/gxh/new_openbmc/openbmc/meta-openembedded/meta-python \
  /home/gxh/new_openbmc/openbmc/meta-phosphor \
  /home/gxh/new_openbmc/openbmc/meta-aspeed \
  /home/gxh/new_openbmc/openbmc/meta-openpower \
  /home/gxh/new_openbmc/openbmc/meta-ibm/meta-romulus \
  "
```

## meta-evbcustom/conf/layer.conf
```bitbake
# We have a conf and classes directory, add to BBPATH
BBPATH .= ":${LAYERDIR}"

# We have recipes-* directories, add to BBFILES
BBFILES += "${LAYERDIR}/recipes-*/*/*.bb \
            ${LAYERDIR}/recipes-*/*/*.bbappend"

BBFILE_COLLECTIONS += "meta-evbcustom"
BBFILE_PATTERN_meta-evbcustom = "^${LAYERDIR}/"
BBFILE_PRIORITY_meta-evbcustom = "6"

LAYERDEPENDS_meta-evbcustom = "core"
LAYERSERIES_COMPAT_meta-evbcustom = "scarthgap styhead"
```

## meta-imxcustom/conf/layer.conf
```bitbake
# We have a conf and classes directory, add to BBPATH
BBPATH .= ":${LAYERDIR}"

# We have recipes-* directories, add to BBFILES
BBFILES += "${LAYERDIR}/recipes-*/*/*.bb \
            ${LAYERDIR}/recipes-*/*/*.bbappend"

BBFILE_COLLECTIONS += "meta-imxcustom"
BBFILE_PATTERN_meta-imxcustom = "^${LAYERDIR}/"
BBFILE_PRIORITY_meta-imxcustom = "6"

LAYERDEPENDS_meta-imxcustom = "core"
LAYERSERIES_COMPAT_meta-imxcustom = "scarthgap styhead"
```
